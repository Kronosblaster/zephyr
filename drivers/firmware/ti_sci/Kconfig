## drivers/firmware/ti_sci/Kconfig
```kconfig
# Copyright (c) 2025, Texas Instruments
# SPDX-License-Identifier: Apache-2.0

config TISCI
	bool "TISCI Firmware driver"
	depends on MBOX_TI_SECURE_PROXY
	help
	  TISCI firmware driver is a frontend interface
	  to TI System Controller interface firmware through
	  secureproxy mailbox.

if TISCI

config TISCI_INIT_PRIORITY
	int "TISCI init priority"
	default KERNEL_INIT_PRIORITY_OBJECTS
	help
	  Init priority for the TISCI driver.

config TISCI_RESPONSE_TIMEOUT_MS
	int "TISCI response timeout in milliseconds"
	default 100
	help
	  Timeout in milliseconds to wait for a response from the TISCI firmware.

endif
```

## drivers/mbox/Kconfig.ti_secproxy
```kconfig
# Copyright 2024 Texas Instruments Incorporated.
# SPDX-License-Identifier: Apache-2.0

config MBOX_TI_SECURE_PROXY
	bool "TI Secureproxy Mailbox driver"
	default y
	help
	  Driver for TI Secure Proxy Mailbox.
```

## dts/bindings/power-domain/ti,sci-pm-domain.yaml
```yaml
# Copyright 2024 NXP
# SPDX-License-Identifier: Apache-2.0

description: NXP SCU-managed power domain

compatible: "ti,sci-pm-domain"

include: base.yaml

properties:
  "#power-domain-cells":
    const: 2

power-domain-cells:
  - devid
  - mode
```
